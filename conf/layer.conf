## conf/layer.conf
```bitbake
# We have a conf and classes directory, add to BBPATH
BBPATH .= ":${LAYERDIR}"
# We have recipes-* directories, add to BBFILES
BBFILES += "${LAYERDIR}/recipes-*/*/*.bb \
 ${LAYERDIR}/recipes-*/*/*.bbappend"

BBFILE_COLLECTIONS += "pedalpi"
BBFILE_PATTERN_pedalpi = "^${LAYERDIR}/"
BBFILE_PRIORITY_pedalpi = "6"
LAYERSERIES_COMPAT_pedalpi = "zeus"
```
